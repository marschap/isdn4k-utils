## isdnlog/Config.in
```kconfig
mainmenu_option next_comment
comment 'Options for isdnlog package'
string 'Old config directory' CONFIG_ISDNLOG_OLDI4LCONFDIR '/etc/isdnlog'
string 'Old config file' CONFIG_ISDNLOG_OLDI4LCONFFILE 'isdnlog.conf'
bool 'Use AreaCode by uz@musoftware.com' CONFIG_ISDNLOG_AREACODE
bool 'Support postgres95 SQL-Database' CONFIG_ISDNLOG_POSTGRES
bool 'Support for old isdn4linux' CONFIG_ISDNLOG_OLD_I4L
choice 'Country specific chargeinfo support' \
	"DE CONFIG_ISDNLOG_DE \
	NL CONFIG_ISDNLOG_NL \
	CH CONFIG_ISDNLOG_CH" DE
endmenu
```

## scripts/config.in
```kconfig
#
# The whole configuration stuff is borrowed from the kernel
# configuration.
#
# For a description of the syntax of this configuration file,
# see the Menuconfig script.
#
if [ "`type -p xmkmf`" != "" ]; then
CONFIG_HASX11=y
fi
mainmenu_name "isdn4k-utils Configuration"

mainmenu_option next_comment
comment 'Code maturity level options'
bool 'Prompt for development and/or incomplete code' CONFIG_EXPERIMENTAL
endmenu
mainmenu_option next_comment
comment 'General configuration'
comment 'Build options'
bool 'Build programs which need X11 installed' CONFIG_BUILDX11
comment 'Destination directories'
string 'Directory to install binaries' CONFIG_BINDIR /usr/bin
string 'Directory to install admin binaries' CONFIG_SBINDIR /sbin
string 'Directory to install man pages' CONFIG_MANDIR /usr/man
comment 'Runtime defaults'
string 'Write .pid files here' CONFIG_RUNDIR /var/run
string 'General configuration directory' CONFIG_I4LCONFDIR /etc/isdn
string 'Global configuration file' CONFIG_CONFFILE isdn.conf
string 'User configuration file' CONFIG_USERCONFFILE .isdn
comment 'Configuration library options'
string 'Default country prefix' CONFIG_COUNTRY_PREFIX +
string 'Default area prefix' CONFIG_AREA_PREFIX 0
choice 'Database for area codes' \
        "Areacode CONFIG_LIB_AREACODE \
        Avon CONFIG_LIB_AVON" Areacode
if [ "$CONFIG_LIB_AREACODE" = "y" ]; then
	string 'Directory to install areacodes' CONFIG_AREACODE_DATA /usr/lib/isdn
fi
if [ "$CONFIG_LIB_AVON" = "y" ]; then
	string 'Directory to install avon database' CONFIG_AVON_DATA /usr/lib/isdn
fi
endmenu
mainmenu_option nextcomment
comment 'Runtime configuration tools'
bool 'isdnctrl' CONFIG_ISDNCTRL
if [ "$CONFIG_ISDNCTRL" = "y" ]; then
	bool 'Enable isdnctrl debug-option' CONFIG_ISDNCTRL_DEBUG
fi
bool 'iprofd' CONFIG_IPROFD
endmenu
mainmenu_option nextcomment
comment 'Card configuration tools'
bool 'telesctrl' CONFIG_TELESCTRL
bool 'hisaxctrl' CONFIG_HISAXCTRL
bool 'icnctrl' CONFIG_ICNCTRL
if [ "$CONFIG_ICNCTRL" = "y" ]; then
	bool 'Enable icnctl debug-option' CONFIG_ICNCTRL_DEBUG
fi
bool 'pcbitctl' CONFIG_PCBITCTL
endmenu
mainmenu_option nextcomment
comment 'Tools for monitoring activity'
bool 'imon' CONFIG_IMON
bool 'imontty' CONFIG_IMONTTY
bool 'isdnlog' CONFIG_ISDNLOG
if [ "$CONFIG_ISDNLOG" = "y" ] ; then
	source isdnlog/.Config.in
fi
dep_bool 'xisdnload' CONFIG_XISDNLOAD CONFIG_BUILDX11
dep_bool 'xmonisdn' CONFIG_XMONISDN CONFIG_BUILDX11
if [ "$CONFIG_XMONISDN" = "y" ] ; then
	mainmenu_option nextcomment
	comment 'Options for xmonisdn'
	string 'NetUP command' CONFIG_XMONISDN_UPCMD '/sbin/netup'
	string 'NetDOWN command' CONFIG_XMONISDN_DOWNCMD '/sbin/netdown'
	endmenu
fi
endmenu
mainmenu_option nextcomment
comment 'Applications'
bool 'vbox' CONFIG_VBOX
if [ "$CONFIG_VBOX" = "y" ]; then
	source vbox/.Config.in
fi
endmenu
mainmenu_option nextcomment
comment 'Documentation'
bool 'Install generic pages' CONFIG_GENMAN
bool 'Generate FAQ' CONFIG_FAQ
if [ "$CONFIG_FAQ" = "y" ]; then
	string 'Directory to install FAQ' CONFIG_FAQDIR /usr/doc/faq/isdn4linux
fi
endmenu
```
